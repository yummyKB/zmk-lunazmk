## config/boards/shields/chipper/Kconfig.shield
```kconfig
# Copyright (c) 2020 Pete Johanson
# SPDX-License-Identifier: MIT

config SHIELD_LUNAZMK_LEFT
	def_bool $(shields_list_contains,lunazmk_left)

config SHIELD_LUNAZMK_RIGHT
	def_bool $(shields_list_contains,lunazmk_right)
```

## config/boards/shields/lunazmk/Kconfig.defconfig
```kconfig
if SHIELD_LUNAZMK_L

config ZMK_KEYBOARD_NAME
    default "lunazmk_L"

config ZMK_SPLIT
    default y

config ZMK_SPLIT_ROLE_CENTRAL
    default y

config I2C
    default y

config ZMK_POINTING
    default y

config AZ1UBALL
    default y

endif

if SHIELD_LUNAZMK_R

config ZMK_KEYBOARD_NAME
    default "lunazmk_R"

config ZMK_SPLIT
    default y

endif
```

## config/boards/shields/lunazmk/Kconfig.shield
```kconfig
# Copyright (c) 2020 Pete Johanson
# SPDX-License-Identifier: MIT

config SHIELD_LUNAZMK_L
	def_bool $(shields_list_contains,lunazmk_L)

config SHIELD_LUNAZMK_R
	def_bool $(shields_list_contains,lunazmk_R)
```
