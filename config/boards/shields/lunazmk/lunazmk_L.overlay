/*
 * Copyright (c) 2020 Pete Johanson
 *
 * SPDX-License-Identifier: MIT
 */

#include "lunazmk.dtsi"
#include <input/processors.dtsi>
#include <dt-bindings/zmk/input_transform.h>

&kscan0 {
    col-gpios = <&gpio0 10 GPIO_ACTIVE_HIGH>,
                <&gpio1 15 GPIO_ACTIVE_HIGH>,
                <&gpio1 14 GPIO_ACTIVE_HIGH>,
                <&gpio1 13 GPIO_ACTIVE_HIGH>,
                <&gpio1 12 GPIO_ACTIVE_HIGH>,
                <&gpio1 11 GPIO_ACTIVE_HIGH>
                ;
};

&trackball_input_listener_1 {
    status = "okay";
    device = <&trackball>;
    input-processors = <&zip_xy_scaler 16 16>,
                       <&zip_xy_transform (INPUT_TRANSFORM_XY_SWAP | INPUT_TRANSFORM_X_INVERT)>;
};

/*
&trackball_input_listener_0 {
    status = "okay";
};
*/

&xiao_i2c {
    status = "okay";
    clock-frequency = <I2C_BITRATE_FAST>;
    trackball: trackball@0a {
        compatible = "palette,az1uball";
        reg = <0x0A>;
        status = "okay";
        default-mode = "mouse";
        sensitivity = "4x";
        flip_x;
        flip_y;
    };
};

