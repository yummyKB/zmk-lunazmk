## config/west.yml
```yaml
manifest:
  remotes:
    - name: zmkfirmware
      url-base: https://github.com/zmkfirmware
    - name: yummyKB
      url-base: https://github.com/yummyKB

  projects:
    - name: zmk
      remote: zmkfirmware
      revision: main
      import: app/manifest/zephyr/west.yml

    - name: zmk-az1uball-driver
      remote: yummyKB
      revision: main

  self:
    path: config
```
